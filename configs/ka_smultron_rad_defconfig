## drivers/cpufreq/Kconfig
```kconfig
config CPU_FREQ
	bool "CPU Frequency scaling"
	help
	  CPU Frequency scaling allows you to change the clock speed of 
	  CPUs on the fly. This is a nice method to save power, because 
	  the lower the CPU clock speed, the less power the CPU consumes.

	  Note that this driver doesn't automatically change the CPU
	  clock speed, you need to either enable a dynamic cpufreq governor
	  (see below) after boot, or use a userspace tool.

	  For details, take a look at <file:Documentation/cpu-freq>.

	  If in doubt, say N.

if CPU_FREQ

config CPU_FREQ_TABLE
	tristate

config CPU_FREQ_DEBUG
	bool "Enable CPUfreq debugging"
	help
	  Say Y here to enable CPUfreq subsystem (including drivers)
	  debugging. You will need to activate it via the kernel
	  command line by passing
	     cpufreq.debug=<value>

	  To get <value>, add 
	       1 to activate CPUfreq core debugging,
	       2 to activate CPUfreq drivers debugging, and
	       4 to activate CPUfreq governor debugging

config CPU_FREQ_STAT
	tristate "CPU frequency translation statistics"
	select CPU_FREQ_TABLE
	default y
	help
	  This driver exports CPU frequency statistics information through sysfs
	  file system.

	  To compile this driver as a module, choose M here: the
	  module will be called cpufreq_stats.

	  If in doubt, say N.

config CPU_FREQ_STAT_DETAILS
	bool "CPU frequency translation statistics details"
	depends on CPU_FREQ_STAT
	help
	  This will show detail CPU frequency translation table in sysfs file
	  system.

	  If in doubt, say N.

choice
	prompt "Default CPUFreq governor"
	default CPU_FREQ_DEFAULT_GOV_USERSPACE if CPU_FREQ_SA1100 || CPU_FREQ_SA1110
	default CPU_FREQ_DEFAULT_GOV_PERFORMANCE
	help
	  This option sets which CPUFreq governor shall be loaded at
	  startup. If in doubt, select 'performance'.

config CPU_FREQ_DEFAULT_GOV_PERFORMANCE
	bool "performance"
	select CPU_FREQ_GOV_PERFORMANCE
	help
	  Use the CPUFreq governor 'performance' as default. This sets
	  the frequency statically to the highest frequency supported by
	  the CPU.


config CPU_FREQ_DEFAULT_GOV_ONDEMAND
	bool "ondemand"
	select CPU_FREQ_GOV_ONDEMAND
	select CPU_FREQ_GOV_PERFORMANCE
	help
	  Use the CPUFreq governor 'ondemand' as default. This allows
	  you to get a full dynamic frequency capable system by simply
	  loading your cpufreq low-level hardware driver.
	  Be aware that not all cpufreq drivers support the ondemand
	  governor. If unsure have a look at the help section of the
	  driver. Fallback governor will be the performance governor.


config CPU_FREQ_DEFAULT_GOV_VIRTUOUS
	bool "virtuous"
	select CPU_FREQ_GOV_VIRTUOUS
	select CPU_FREQ_GOV_PERFORMANCE
	help
	  Use the CPUFreq governor 'smartass' as default.



config CPU_FREQ_DEFAULT_GOV_INTERACTIVE
	bool "interactive"
	select CPU_FREQ_GOV_INTERACTIVE
	help
	 Use the 'interactive' governor as default. This gets full cpu frequency
	 scaling for workloads that are latency sensitive, typically interactive
	 workloads..

config CPU_FREQ_DEFAULT_GOV_LULZACTIVE  
        bool "lulzactive" 
        select CPU_FREQ_GOV_LULZACTIVE 
        select CPU_FREQ_GOV_PERFORMANCE 
        help 
          Use the CPUFreq governor 'lulzactive' as default. 

config CPU_FREQ_DEFAULT_GOV_SMARTASSH3
	bool "smartassH3"
	select CPU_FREQ_GOV_SMARTASSH3
	help
	Use the CPUFreq governor 'SmartassH3' as default.


endchoice 

config CPU_FREQ_GOV_PERFORMANCE
	tristate "'performance' governor"
	help
	  This cpufreq governor sets the frequency statically to the
	  highest available CPU frequency.

	  To compile this driver as a module, choose M here: the
	  module will be called cpufreq_performance.

	  If in doubt, say Y.


config CPU_FREQ_GOV_ONDEMAND
	tristate "'ondemand' cpufreq policy governor"
	select CPU_FREQ_TABLE
	help
	  'ondemand' - This driver adds a dynamic cpufreq policy governor.
	  The governor does a periodic polling and 
	  changes frequency based on the CPU utilization.
	  The support for this governor depends on CPU capability to
	  do fast frequency switching (i.e, very low latency frequency
	  transitions). 

	  To compile this driver as a module, choose M here: the
	  module will be called cpufreq_ondemand.

	  For details, take a look at linux/Documentation/cpu-freq.

	  If in doubt, say N.

config CPU_FREQ_GOV_VIRTUOUS
	tristate "'virtuous' cpufreq governor"
	depends on CPU_FREQ
	help
          'virtuous' - a "slightly more agressive smart" optimized governor!
 
	  If in doubt, say N.

config CPU_FREQ_GOV_INTERACTIVE
	tristate "'interactive' cpufreq policy governor"
	help
	 'interactive' - This driver adds a dynamic cpufreq policy governor.
	 Designed for low latency burst workloads. Scaling it done when coming
	 out of idle instead of polling.

config CPU_FREQ_VDD_LEVELS
	bool "CPU Vdd levels sysfs interface"
	depends on CPU_FREQ_STAT
	depends on ARCH_MSM7X30
	default n
	help
	  CPU Vdd levels sysfs interface

config CPU_FREQ_GOV_LULZACTIVE 
        tristate "'lulzactive' cpufreq governor" 
        depends on CPU_FREQ 
        help 
       'lulzactive' - a new interactive governor by Tegrak! 

        If in doubt, say N.

config CPU_FREQ_GOV_SMARTASSH3
	tristate "'SmartassH3' cpufreq governor"
	depends on CPU_FREQ
	help
	  SmartassH3 - a "smartassV2 with tweaks by H3ROS" governor!

	  If in doubt, say N.

config CPU_FREQ_MIN_TICKS
	int "Ticks between governor polling interval."
	default 10
	help
	  Minimum number of ticks between polling interval for governors.

config CPU_FREQ_SAMPLING_LATENCY_MULTIPLIER
	int "Sampling rate multiplier for governors."
	default 1000
	help
	  Sampling latency rate multiplied by the cpu switch latency.
	  Affects governor polling.

endif	# CPU_FREQ
```
